/* Copyright (c) 2015, The Linux Foundation. All rights reserved.
 *
 * This program is free software; you can redistribute it and/or modify
 * it under the terms of the GNU General Public License version 2 and
 * only version 2 as published by the Free Software Foundation.
 *
 * This program is distributed in the hope that it will be useful,
 * but WITHOUT ANY WARRANTY; without even the implied warranty of
 * MERCHANTABILITY or FITNESS FOR A PARTICULAR PURPOSE.  See the
 * GNU General Public License for more details.
 */

&mdss_mdp {
	dsi_lead_td4310_5p99_1080P_video: qcom,mdss_dsi_lead_td4310_5p99_1080P_video {
		qcom,mdss-dsi-panel-name = "zfgLEAD_TD4310_1080_2160_5P99Inch";
		qcom,mdss-dsi-panel-type = "dsi_video_mode";
		qcom,cont-splash-enabled;
		qcom,mdss-dsi-panel-status-read-length = <1>;
		qcom,mdss-pan-physical-width-dimension = <75>;
		qcom,mdss-pan-physical-height-dimension = <132>;
		qcom,mdss-dsi-panel-framerate = <60>;
		qcom,mdss-dsi-virtual-channel-id = <0>;
		qcom,mdss-dsi-stream = <0>;
		qcom,mdss-dsi-panel-width = <1080>;
		qcom,mdss-dsi-panel-height = <2160>;/*mipi=830.01MHz*/
		qcom,mdss-dsi-h-front-porch = <108>;
		qcom,mdss-dsi-h-back-porch = <60>;
		qcom,mdss-dsi-h-pulse-width = <10>;
		qcom,mdss-dsi-h-sync-skew = <0>;
		qcom,mdss-dsi-v-back-porch = <33>;
		qcom,mdss-dsi-v-front-porch = <8>;
		qcom,mdss-dsi-v-pulse-width = <2>;
		qcom,mdss-dsi-h-left-border = <0>;
		qcom,mdss-dsi-h-right-border = <0>;
		qcom,mdss-dsi-v-top-border = <0>;
		qcom,mdss-dsi-v-bottom-border = <0>;
		qcom,mdss-dsi-bpp = <24>;
		qcom,mdss-dsi-underflow-color = <0xff>;
		qcom,mdss-dsi-border-color = <0>;
		qcom,mdss-dsi-h-sync-pulse = <0>;
		qcom,mdss-dsi-traffic-mode = "burst_mode";

		qcom,mdss-dsi-te-pin-select = <1>;
		qcom,mdss-dsi-te-dcs-command = <1>;
		qcom,mdss-dsi-te-check-enable;
		qcom,mdss-dsi-te-using-te-pin;
		qcom,mdss-dsi-wr-mem-start = <0x2c>;
		qcom,mdss-dsi-wr-mem-continue = <0x3c>;

		qcom,mdss-dsi-lp11-init;
		//qcom,mdss-dsi-init-delay-us = <5000>;

		//qcom,esd-check-enabled;
		qcom,mdss-dsi-panel-status-command=[06 01 00 01 05 00 01 0e] ;
		qcom,mdss-dsi-panel-status-command-state="dsi_lp_mode";
		qcom,mdss-dsi-panel-status-check-mode="reg_read";
		qcom,mdss-dsi-panel-status-value=<0x80>;

		qcom,mdss-dsi-bllp-eof-power-mode;
		qcom,mdss-dsi-bllp-power-mode;
		qcom,mdss-dsi-lane-0-state;
		qcom,mdss-dsi-lane-1-state;
		qcom,mdss-dsi-lane-2-state;
		qcom,mdss-dsi-lane-3-state;
		qcom,mdss-dsi-panel-timings = [EE 38 26 00 6A 6C 2C 3C 2C 03 04 00];
		//qcom,mdss-dsi-panel-timings-phy-v2 = [
		//23 1e 07 08 05 03 04 a0
		//23 1e 07 08 05 03 04 a0
		//23 1e 07 08 05 03 04 a0
		//23 1e 07 08 05 03 04 a0
		//23 19 07 08 05 03 04 a0];
		qcom,mdss-dsi-t-clk-post = <0x02>;
		qcom,mdss-dsi-t-clk-pre = <0x2C>;
		qcom,mdss-dsi-bl-min-level = <1>;
		qcom,mdss-dsi-bl-max-level = <255>;
		qcom,mdss-dsi-dma-trigger = "trigger_sw";
		qcom,mdss-dsi-mdp-trigger = "none";
		qcom,mdss-dsi-on-command = [
29 01 00 00 00 00 02 B0 00
29 01 00 00 00 00 02 D6 01
29 01 00 00 00 00 1A CE DD 40 49 53 59 5e 63 68 6e 74 7e 8a 98 a8 bb d0 ff 03 6A 04 04 42 04 69 5a
39 01 00 00 00 00 02 36 00
39 01 00 00 00 00 02 35 00
39 01 00 00 00 00 02 55 00
39 01 00 00 00 00 02 51 FF
39 01 00 00 00 00 02 53 2C
05 01 00 00 64 00 01 11
05 01 00 00 16 00 01 29
			];
		qcom,mdss-dsi-off-command = [05 01 00 00 96 00 02 28 00
				05 01 00 00 96 00 02 10 00
				39 01 00 00 00 00 02 4f 01];
		qcom,mdss-dsi-on-command-state = "dsi_lp_mode";
		qcom,mdss-dsi-off-command-state = "dsi_hs_mode";
		qcom,mdss-dsi-bl-pmic-control-type ="bl_ctrl_dcs";
		qcom,mdss-dsi-reset-sequence = <1 5>, <0 5>, <1 30>;
		//qcom,mdss-dsi-tx-eot-append;
	};
};
