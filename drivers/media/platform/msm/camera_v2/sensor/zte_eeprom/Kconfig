## drivers/media/platform/msm/camera_v2/sensor/zte_eeprom/Kconfig
```kconfig
config IMX351_EEPROM
	bool "ZFG IMX351 Calibration support"
	depends on MSMB_CAMERA
	help
	  Enable support for ROM Interface for Calibration
	  Provides interface for reading the Claibration data.
	  and also provides support for writing data in case of FLASH ROM.
	  Currently supports CCI  protocol

config OV8856_EEPROM
	bool "ZFG OV8856 Calibration support"
	depends on MSMB_CAMERA
	help
	  Enable support for ROM Interface for Calibration
	  Provides interface for reading the Claibration data.
	  and also provides support for writing data in case of FLASH ROM.
	  Currently supports CCI  protocol

config HI846_EEPROM
	bool "ZFG HI846 Calibration support"
	depends on MSMB_CAMERA
	help
	  Enable support for ROM Interface for Calibration
	  Provides interface for reading the Claibration data.
	  and also provides support for writing data in case of FLASH ROM.
	  Currently supports CCI  protocol

config OV16B10_031_EEPROM
	bool "ZFG OV16B10_031 Calibration support"
	depends on MSMB_CAMERA
	help
	  Enable support for ROM Interface for Calibration
	  Provides interface for reading the Claibration data.
	  and also provides support for writing data in case of FLASH ROM.
	  Currently supports CCI  protocol

config S5K4H7_127_EEPROM
	bool "ZFG S5K4H7_127 Calibration support"
	depends on MSMB_CAMERA
	help
	  Enable support for ROM Interface for Calibration
	  Provides interface for reading the Claibration data.
	  and also provides support for writing data in case of FLASH ROM.
	  Currently supports CCI  protocol

config IMX351_033_EEPROM
	bool "ZFG IMX351_033 Calibration support"
	depends on MSMB_CAMERA
	help
	  Enable support for ROM Interface for Calibration
	  Provides interface for reading the Claibration data.
	  and also provides support for writing data in case of FLASH ROM.
	  Currently supports CCI  protocol

config IMX351_032_EEPROM
	bool "ZFG IMX351_032 Calibration support"
	depends on MSMB_CAMERA
	help
	  Enable support for ROM Interface for Calibration
	  Provides interface for reading the Claibration data.
	  and also provides support for writing data in case of FLASH ROM.
	  Currently supports CCI  protocol

config S5K4H7_Z610CA_127_EEPROM
	bool "ZFG S5K4H7_Z610CA_127 Calibration support"
	depends on MSMB_CAMERA
	help
	  Enable support for ROM Interface for Calibration
	  Provides interface for reading the Claibration data.
	  and also provides support for writing data in case of FLASH ROM.
	  Currently supports CCI  protocol


config S5K3L6_035_EEPROM
	bool "ZFG S5K3L6_035 Calibration support"
	depends on MSMB_CAMERA
	default n
	help
	  Enable support for ROM Interface for Calibration
	  Provides interface for reading the Claibration data.
	  and also provides support for writing data in case of FLASH ROM.
	  Currently supports CCI  protocol

config OV13855_035_EEPROM
	bool "ZFG OV13855_035 Calibration support"
	depends on MSMB_CAMERA
	default n
	help
	  Enable support for ROM Interface for Calibration
	  Provides interface for reading the Claibration data.
	  and also provides support for writing data in case of FLASH ROM.
	  Currently supports CCI  protocol

config OV16885_4C_039_EEPROM
	bool "ZFG OV16885_4C_039 Calibration support"
	depends on MSMB_CAMERA
	help
	  Enable support for ROM Interface for Calibration
	  Provides interface for reading the Claibration data.
	  and also provides support for writing data in case of FLASH ROM.
	  Currently supports CCI  protocol
```

## drivers/soc/qcom/vendor/Kconfig
```kconfig
source "drivers/soc/qcom/vendor/vlog/Kconfig"
source "drivers/soc/qcom/vendor/fuseinfo/Kconfig"
```

## drivers/soc/qcom/vendor/fuseinfo/Kconfig
```kconfig
#
# show the fuse state
#
config SHOW_FUSE_INFO
  bool "show the fuse status"
  default n
  help
  This driver will read fuse status from MSM IC and show with sysfs file.
```

## drivers/video/msm/Kconfig
```kconfig
source "drivers/video/msm/ba/Kconfig"
source "drivers/video/msm/msm_dba/Kconfig"

if FB_MSM
config FB_MSM_MDSS_COMMON
	bool

choice
	prompt "MDP HW version"
	default FB_MSM_MDP

config FB_MSM_MDP
	bool "MDP HW"
	---help---
	  Support for MSM MDP HW revision 2.2
	  Say Y here if this is msm7201 variant platform.

config FB_MSM_MDSS
	bool "MDSS HW"
	select SYNC
	select SW_SYNC
	select FB_MSM_MDSS_COMMON
	---help---
	The Mobile Display Sub System (MDSS) driver supports devices which
	contain MDSS hardware block.

	The MDSS driver implements frame buffer interface to provide access to
	the display hardware and provide a way for users to display graphics
	on connected display panels.

config FB_MSM_MDP_NONE
	bool "MDP HW None"
	---help---
	  Say Y here if this is mdm platform.

endchoice

config FB_MSM_QPIC
	bool
	select FB_MSM_MDSS_COMMON

config FB_MSM_QPIC_ILI_QVGA_PANEL
	bool "Qpic MIPI ILI QVGA Panel"
	select FB_MSM_QPIC
	---help---
	  Support for MIPI ILI QVGA (240x320) panel
	  ILI TECHNOLOGY 9341
	  with on-chip full display RAM
	  use parallel interface

config FB_MSM_QPIC_PANEL_DETECT
	bool "Qpic Panel Detect"
	select FB_MSM_QPIC_ILI_QVGA_PANEL
	---help---
	  Support for Qpic panel auto detect

if FB_MSM_MDSS
	source "drivers/video/msm/mdss/Kconfig"
endif

#
config ZFG_LCD_COMMON_FUNCTION
	bool "Support for ZFG lcd common function"
	default y

config ZFG_LCD_BACKLIGHT_LEVEL_CURVE
	depends on ZFG_LCD_COMMON_FUNCTION
	bool "Support for ZFG lcd backlight curve"

config ZFG_LCD_REG_DEBUG
	depends on ZFG_LCD_COMMON_FUNCTION
	bool "Support lcd register debug in root version"

config ZFG_LCD_GPIO_CTRL_POWER
	depends on ZFG_LCD_COMMON_FUNCTION
	bool "Support for ZFG gpio power ctrl"

config ZFG_LCDBL_I2C_CTRL_VSP_VSN
	depends on ZFG_LCD_COMMON_FUNCTION
	bool "Support for ZFG vsp vsn power ctrl"

config ZFG_LCD_DCSBL_CABC_GRADIENT
	depends on ZFG_LCD_COMMON_FUNCTION
	bool "Support for ZFG dcs bl cabc gradient effect"

config ZFG_LCD_CABC3_EXTREME_POWER_SAVE
	depends on ZFG_LCD_COMMON_FUNCTION
	bool "Support for ZFG extreme power save modem cabc"
#
endif
```
